/dts-v1/;
/plugin/;
/ {
	fragment@0 {
		target = <&spi0>;
		__overlay__ {
			pinctrl-names = "default";
			pinctrl-0 = <&spi0m2_pins &spi0m2_cs0 &spi0m2_cs1>;
			status = "okay";
		};
	};
	fragment@1 {
		target = <&spi3>;
		__overlay__ {
			pinctrl-names = "default";
			pinctrl-0 = <&spi3m1_pins &spi3m1_cs0 &spi3m1_cs1>;
			status = "okay";
		};
	};
};
