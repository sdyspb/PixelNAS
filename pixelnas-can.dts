/dts-v1/;
/plugin/;
/ {
	fragment@0 {
		target = <&can0>;
		__overlay__ {
			status = "okay";
			assigned-clocks = <&cru 0x70>;					// CLK_CAN?
			assigned-clock-rates = <200000000>;
			pinctrl-names = "default";
			pinctrl-0 = <0x00 0x10 0x0b 0x18d 0x00 0x0f 0x0b 0x18d>;	// &can0m0_pins
		};
	};
	fragment@1 {
		target = <&can1>;
		__overlay__ {
			status = "okay";
			assigned-clocks = <&cru 0x72>;					// CLK_CAN1
			assigned-clock-rates = <200000000>;
			pinctrl-names = "default";
			pinctrl-0 = <0x04 0x0a 0x0c 0x18d 0x04 0x0b 0x0c 0x18d>;	// &can1m1_pins
		};
	};
};
