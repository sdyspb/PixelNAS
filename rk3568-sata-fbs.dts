/dts-v1/;
/plugin/;

/ {
    fragment@0 {
        target-path = "/sata@fc800000";
        __overlay__ {
            #address-cells = <1>;
            #size-cells = <0>;

            sata-port@0 {
                reg = <0>;
                hba-port-cap = <0x400000>;
                phys = <&combphy2 1>;
                phy-names = "sata-phy";
                snps,rx-ts-max = <32>;
                snps,tx-ts-max = <32>;
            };
        };
    };
};
